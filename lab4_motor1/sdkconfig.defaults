## lab4_motor1/sdkconfig.defaults
```kconfig
CONFIG_IDF_TARGET="esp32"
CONFIG_FREERTOS_HZ=1000
CONFIG_ESP_CONSOLE_UART_DEFAULT=y
CONFIG_ESP_CONSOLE_UART_BAUDRATE=115200
CONFIG_LOG_DEFAULT_LEVEL_WARN=y
CONFIG_ESP_BROWNOUT_DET=y
```

## src/Kconfig.projbuild
```kconfig
menu "SCARA firmware"

    config SCARA_COMMS_UROS
        bool "Comunicacion por micro-ROS (ROS 2) en lugar del protocolo de texto"
        default n
        help
            n = protocolo de texto por serial (comms.c, monitor de PlatformIO o tools/teleop.py).
            y = micro-ROS (uros_comms.c). Requiere el componente micro_ros_espidf_component en
                components/ y usar tools/uros_select.py para dejar la configuracion consistente.

    config SCARA_UROS_STACK
        int "Pila de la tarea micro-ROS (bytes)"
        default 16000
        depends on SCARA_COMMS_UROS

    config SCARA_UROS_PRIO
        int "Prioridad de la tarea micro-ROS"
        default 5
        depends on SCARA_COMMS_UROS

    config SCARA_UROS_BAUD
        int "Velocidad del transporte serial de micro-ROS (baudios)"
        default 115200
        depends on SCARA_COMMS_UROS
        help
            Debe coincidir con "-b" del agente micro-ROS. Sube a 460800 o 921600 cuando todo funcione.

endmenu
```
